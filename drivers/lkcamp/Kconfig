## drivers/lkcamp/Kconfig
```kconfig
config LKCAMP_CHAR
    default m
    tristate "LKCamp char module"
    help
        Provides a char module, to understand the 'read' and
        'write' functions of modules.
        This module was created for educational purposes, inside
        a lkcamp activity for linux kernel development workshop.
        The default configuration is 'm': the module will be compiled
        and it will be available to be loaded in execution time.
```

## drivers/trabalho3/Kconfig
```kconfig
config CAESAR_DRIVER
    default m
    tristate "Caesar Cipher pseudo-device driver"
    help
      This module creates a pseudo-device at /dev/caesar that implements
      the Caesar cipher encryption and decryption algorithm.

      When you write text to the device, it is stored in a kernel buffer.
      You can then use ioctl commands to encrypt the text, decrypt the text,
      or set a new cipher key. Reading from the device will return the
      processed text from the buffer. The driver also supports lseek to allow
      reading the buffer multiple times within the same session.

      The default configuration is 'm': the module will be compiled
      and it will be available to be loaded at runtime.
```
